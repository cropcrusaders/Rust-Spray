## yocto/build/conf/bblayers.conf
```bitbake
BBPATH = "${TOPDIR}" 
BBFILES ?= ""

POKY_BBLAYERS := " \ 
  ${TOPDIR}/../poky/meta \ 
  ${TOPDIR}/../poky/meta-poky \ 
  ${TOPDIR}/../poky/meta-yocto-bsp \
  ${TOPDIR}/../meta-rust-spray \
  ${TOPDIR}/../meta-openembedded/meta-oe \
  "

BBLAYERS ?= "${POKY_BBLAYERS}"
```

## yocto/build/conf/local.conf
```bitbake
MACHINE ??= "qemuarm64"
DISTRO ?= "poky"
PACKAGE_CLASSES ?= "package_rpm"
# The old "debug-tweaks" image feature was removed in newer
# Yocto releases. Use the equivalent features directly.
EXTRA_IMAGE_FEATURES ?= "allow-root-login allow-empty-password"
# The image-prelink class was removed from newer Yocto releases.
# Remove it from USER_CLASSES to avoid parse errors.
USER_CLASSES ?= "buildstats"
TMPDIR = "${TOPDIR}/tmp"

BB_NUMBER_THREADS = "4"
PARALLEL_MAKE = "-j 4"

IMAGE_FSTYPES += "wic"

# Add rust support
RUSTFLAGS = ""
```

## yocto/meta-rust-spray/conf/layer.conf
```bitbake
# Minimal layer configuration for Rust-Spray Yocto layer
BBPATH .= ":${LAYERDIR}"
# Include both one-level and two-level recipe directories so that
# image recipes placed directly under "recipes-<category>" are picked up.
BBFILES += "${LAYERDIR}/recipes-*/*.bb ${LAYERDIR}/recipes-*/*/*.bb"
BBFILE_COLLECTIONS += "meta-rust-spray"
BBFILE_PATTERN_meta-rust-spray = "^${LAYERDIR}/"
BBFILE_PRIORITY_meta-rust-spray = "6"

# Declare compatibility with recent Yocto releases. This silences
# warnings during the build.
LAYERSERIES_COMPAT_meta-rust-spray = "nanbield scarthgap walnascar"
```
